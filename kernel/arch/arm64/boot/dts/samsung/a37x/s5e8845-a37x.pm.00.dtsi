/*
 * SAMSUNG S5E8845 Camera PMIC device tree source
 *
 * Copyright (c) 2026 Samsung Electronics Co., Ltd.
 *             http://www.samsung.com
 *
 * EXYNOS based board files can include this file and provide
 * values for board specific bindings.
 *
 * This program is free software; you can redistribute it and/or modify
 * it under the terms of the GNU General Public License version 2 as
 * published by the Free Software Foundation.
 */

&et5917_0_pmic {
	/* Push-pull mode */
	et5917,et5917_int_outmode = <0>;
};
